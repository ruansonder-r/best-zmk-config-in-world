&nice_view_spi {
    cs-gpios = <&pro_micro 0 GPIO_ACTIVE_HIGH>;
};

&nice_view_spi_sck {
    drive-strength = <2>;
};

&nice_view_spi_mosi {
    drive-strength = <2>;
};

&nice_view_spi_cs {
    drive-strength = <2>;
}; 
